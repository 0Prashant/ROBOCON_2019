
/**
  ******************************************************************************
  * @file           : main.c
  * @brief          : Main program body
  ******************************************************************************
  ** This notice applies to any and all portions of this file
  * that are not between comment pairs USER CODE BEGIN and
  * USER CODE END. Other portions of this file, whether 
  * inserted by the user or by software development tools
  * are owned by their respective copyright owners.
  *
  * COPYRIGHT(c) 2018 STMicroelectronics
  *
  * Redistribution and use in source and binary forms, with or without modification,
  * are permitted provided that the following conditions are met:
  *   1. Redistributions of source code must retain the above copyright notice,
  *      this list of conditions and the following disclaimer.
  *   2. Redistributions in binary form must reproduce the above copyright notice,
  *      this list of conditions and the following disclaimer in the documentation
  *      and/or other materials provided with the distribution.
  *   3. Neither the name of STMicroelectronics nor the names of its contributors
  *      may be used to endorse or promote products derived from this software
  *      without specific prior written permission.
  *
  * THIS SOFTWARE IS PROVIDED BY THE COPYRIGHT HOLDERS AND CONTRIBUTORS "AS IS"
  * AND ANY EXPRESS OR IMPLIED WARRANTIES, INCLUDING, BUT NOT LIMITED TO, THE
  * IMPLIED WARRANTIES OF MERCHANTABILITY AND FITNESS FOR A PARTICULAR PURPOSE ARE
  * DISCLAIMED. IN NO EVENT SHALL THE COPYRIGHT HOLDER OR CONTRIBUTORS BE LIABLE
  * FOR ANY DIRECT, INDIRECT, INCIDENTAL, SPECIAL, EXEMPLARY, OR CONSEQUENTIAL
  * DAMAGES (INCLUDING, BUT NOT LIMITED TO, PROCUREMENT OF SUBSTITUTE GOODS OR
  * SERVICES; LOSS OF USE, DATA, OR PROFITS; OR BUSINESS INTERRUPTION) HOWEVER
  * CAUSED AND ON ANY THEORY OF LIABILITY, WHETHER IN CONTRACT, STRICT LIABILITY,
  * OR TORT (INCLUDING NEGLIGENCE OR OTHERWISE) ARISING IN ANY WAY OUT OF THE USE
  * OF THIS SOFTWARE, EVEN IF ADVISED OF THE POSSIBILITY OF SUCH DAMAGE.
  *
  ******************************************************************************
  */
/* Includes ------------------------------------------------------------------*/
#include "main.h"
#include "stm32f4xx_hal.h"
#include "adc.h"
#include "tim.h"
#include "usart.h"
#include "gpio.h"
#include "dma.h"


/* USER CODE BEGIN Includes */
#include "robo_init.h"
#include "robot.h"
#include "pid.h"
#include <stdlib.h>
#include "drive.h"
//#include "Navigator.h"

/* USER CODE END Includes */

/* Private variables ---------------------------------------------------------*/


/* USER CODE BEGIN PV */
extern double velocity[3];
extern float robotx, roboty, theta;
extern int32_t counts[4] ;
extern struct Str_pid pid[4];

extern struct Str_pid_distance pid_dis_1;
extern struct Str_pid_distance pid_dis_2;
extern struct Str_pid_distance pid_dis_3;
extern uint16_t   update_tick;
extern struct encoder e[4];
float go[460][2] = {{-1225, 1500},
					{10 , 149.248},
					{10 , 60.752},
					{10 , 45.8809},
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					{0,0},};

					
float go_abs[1130][2] = {{500 , 500},
						{510 , 500.05},
						{520 , 500.2},
						{530 , 500.45},
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					{5495 , 9000}};

/* Private variables ---------------------------------------------------------*/

/* USER CODE END PV */

/* Private function prototypes -----------------------------------------------*/
void SystemClock_Config(void);

/* USER CODE BEGIN PFP */
/* Private function prototypes -----------------------------------------------*/


/* USER CODE END PFP */

/* USER CODE BEGIN 0 */

	
struct __FILE{
	
int handle;
};

FILE __stdout;
FILE __stdin;

int fputc(int ch, FILE *f)
{
	ITM_SendChar(ch);
	return(ch);
}



/* USER CODE END 0 */

/**
  * @brief  The application entry point.
  *
  * @retval None
  */
int main(void)
    {
        /* USER CODE BEGIN 1 */ 
        update_tick = HAL_GetTick();
	
        
		set_Gains_distance(&pid_dis_1, 1,0.00,0);	  // 13.55,0.025,300	25.55,0.004,1000
		set_Gains_distance(&pid_dis_2, 1,0.00,000);    // 7.465,0.011,200
		set_Gains_distance(&pid_dis_3, 1.2,0.001,0);
				
        /*  USER CODE END 1 */

        /* MCU Configuration----------------------------------------------------------*/
		
        /* Reset of all peripherals, Initializes the Flash interface and the Systick. */
	    HAL_Init();

        /* USER CODE BEGIN Init */

        /* USER CODE END Init */

        /* Configure the system clock */
        SystemClock_Config();

        /* USER CODE BEGIN SysInit */

        /* USER CODE END SysInit */

        /* Initialize all configured peripherals */
        MX_GPIO_Init();
		MX_DMA_Init();
        MX_ADC1_Init();
        MX_TIM8_Init();
        MX_USART1_UART_Init();
        MX_USART3_UART_Init();
     
        /* USER CODE BEGIN 2 */
				
		wheel_init();
		init_encoder();
		for (uint8_t i = 0; i < 4; ++i) {
			init_PID(&pid[i]);
		}
		
		set_OutputLimit(&pid[0],12,-12);	
		set_OutputLimit(&pid[1],12,-12);
		set_OutputLimit(&pid[2],12,-12);
		set_OutputLimit(&pid[3],12,-12);
		
		HAL_TIM_Base_Start(&htim8);
		HAL_TIM_PWM_Start(&htim8, TIM_CHANNEL_1);
		HAL_TIM_PWM_Start(&htim8, TIM_CHANNEL_2);
		HAL_TIM_PWM_Start(&htim8, TIM_CHANNEL_3);
		HAL_TIM_PWM_Start(&htim8, TIM_CHANNEL_4);
			
		set_Gains(&pid[0], 0.063, 5.2, 0 );
		set_Gains(&pid[1], 0.063, 5.2, 0 );	
		set_Gains(&pid[2], 0.063, 5.2, 0 );	
		set_Gains(&pid[3], 0.063, 5.2, 0 );
	
		/* USER CODE END 2 */
	
			/* Infinite loop */
		int ok;
		
		uint32_t omega_update_tick = HAL_GetTick();
		uint32_t location_recieve_tick = HAL_GetTick();
		/*for (int i=0; i<700; i++)
		{
			ok = goto_absolute_distance(-go_abs[i][0]*0.9, go_abs[i][1]*0.9 ,0);
		}*/
		//ok = goto_absolute_distance(0,1000 ,0);
		ok++;
	float location[3] = {-450,500,0};
	while (1)
	{
		//printf("%d \t%d \t%d \t%d\n", e[0].count, e[1].count, e[2].count, e[3].count);
		HAL_Delay(1);
		//`printf("%f\t%f\n",robotx, roboty);	
		velocity[0]=0;
		velocity[1]=0;
		velocity[2]=0;
		calculate_velocity_with_pid();
		calculate_robot_distance();
		
		/*if((location_recieve_tick - HAL_GetTick())>15)
		{
			location_recieve_tick = HAL_GetTick();
			get_Navigator(location);
		}
			*/
		
		//HAL_Delay(1000);
		//printf("\n%f ", robotx);
        
	/* USER CODE BEGIN WHILE */
	    	  
	}				
	/* USER CODE END WHILE */
            /* USER CODE BEGIN 3 */			
}
		
						
        /* USER CODE END 3 */
	 
			
/**
  * @brief System Clock Configuration
  * @retval None
  */
void SystemClock_Config(void)
{
        RCC_OscInitTypeDef RCC_OscInitStruct;
        RCC_ClkInitTypeDef RCC_ClkInitStruct;

        /**Configure the main internal regulator output voltage 
    */
        __HAL_RCC_PWR_CLK_ENABLE();

        __HAL_PWR_VOLTAGESCALING_CONFIG(PWR_REGULATOR_VOLTAGE_SCALE1);

        /**Initializes the CPU, AHB and APB busses clocks 
    */
        RCC_OscInitStruct.OscillatorType = RCC_OSCILLATORTYPE_HSE;
        RCC_OscInitStruct.HSEState = RCC_HSE_ON;
        RCC_OscInitStruct.PLL.PLLState = RCC_PLL_ON;
        RCC_OscInitStruct.PLL.PLLSource = RCC_PLLSOURCE_HSE;
        RCC_OscInitStruct.PLL.PLLM = 8;
        RCC_OscInitStruct.PLL.PLLN = 336;
        RCC_OscInitStruct.PLL.PLLP = RCC_PLLP_DIV2;
        RCC_OscInitStruct.PLL.PLLQ = 4;
        if (HAL_RCC_OscConfig(&RCC_OscInitStruct) != HAL_OK)
        {
                _Error_Handler(__FILE__, __LINE__);
        }

        /**Initializes the CPU, AHB and APB busses clocks 
    */
        RCC_ClkInitStruct.ClockType = RCC_CLOCKTYPE_HCLK | RCC_CLOCKTYPE_SYSCLK | RCC_CLOCKTYPE_PCLK1 | RCC_CLOCKTYPE_PCLK2;
        RCC_ClkInitStruct.SYSCLKSource = RCC_SYSCLKSOURCE_PLLCLK;
        RCC_ClkInitStruct.AHBCLKDivider = RCC_SYSCLK_DIV1;
        RCC_ClkInitStruct.APB1CLKDivider = RCC_HCLK_DIV4;
        RCC_ClkInitStruct.APB2CLKDivider = RCC_HCLK_DIV2;

        if (HAL_RCC_ClockConfig(&RCC_ClkInitStruct, FLASH_LATENCY_5) != HAL_OK)
        {
                _Error_Handler(__FILE__, __LINE__);
        }

        /**Configure the Systick interrupt time 
    */
        HAL_SYSTICK_Config(HAL_RCC_GetHCLKFreq() / 1000);

        /**Configure the Systick 
    */
        HAL_SYSTICK_CLKSourceConfig(SYSTICK_CLKSOURCE_HCLK);

        /* SysTick_IRQn interrupt configuration */
        HAL_NVIC_SetPriority(SysTick_IRQn, 0, 0);
}


/* USER CODE BEGIN 4 */

/* USER CODE END 4 */

/**
  * @brief  This function is executed in case of error occurrence.
  * @param  file: The file name as string.
  * @param  line: The line in file as a number.
  * @retval None
  */
void _Error_Handler(char *file, int line)
{
        /* USER CODE BEGIN Error_Handler_Debug */
        /* User can add his own implementation to report the HAL error return state */
        while (1)
        {
        }
        /* USER CODE END Error_Handler_Debug */
}

#ifdef USE_FULL_ASSERT
/**
  * @brief  Reports the name of the source file and the source line number
  *         where the assert_param error has occurred.
  * @param  file: pointer to the source file name
  * @param  line: assert_param error line source number
  * @retval None
  */
void assert_failed(uint8_t *file, uint32_t line)
{
        /* USER CODE BEGIN 6 */
        /* User can add his own implementation to report the file name and line number,
     tex: printf("Wrong parameters value: file %s on line %d\r\n", file, line) */
        /* USER CODE END 6 */
}
#endif /* USE_FULL_ASSERT */

/**
  * @}
  */

/**
  * @}
  */

/************************ (C) COPYRIGHT STMicroelectronics *****END OF FILE****/
